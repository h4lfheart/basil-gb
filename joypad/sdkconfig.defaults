## joypad/sdkconfig.defaults
```kconfig
CONFIG_COMPILER_OPTIMIZATION_PERF=y

CONFIG_ESPTOOLPY_FLASHSIZE_8MB=y
CONFIG_PARTITION_TABLE_SINGLE_APP_LARGE=y

CONFIG_ESP_CONSOLE_UART_DEFAULT=y
CONFIG_ESP_CONSOLE_SECONDARY_NONE=y
```
